
/* Environmental Chamber Controller - PID Execution
Author: Reilly Pickard (contact: reilly.pickard@dal.ca)
Last Update: April 5th, 2023
Description: This code accepts the list of inputted temperatures,
humidities, and time scales from a Python GUI to execute PID control 
for an environmental chamber. Feedback is generated by RTDs amplified by Adafruit MAX31865
are used to read temperature off  Pt200 RTDs
*/

// Includes
#include <PID_v1.h>
#include <Adafruit_MAX31865.h>
#include <Adafruit_SPIDevice.h>

// initialize wet and dry RTD's
#define RREF 430
Adafruit_MAX31865 dry = Adafruit_MAX31865(10, 11, 12, 13);
Adafruit_MAX31865 wet = Adafruit_MAX31865(9, 11, 12,13);
// Initialize global variables
double temp_setpoint, temp_input, temp_output;
double hum_setpoint, hum_input, hum_output;
//PID Gains. Tune these for desired response. 
double Kp=10, Ki=0.017, Kd=0.11;
PID tempPID(&temp_input, &temp_output, &temp_setpoint, Kp, Ki, Kd, DIRECT);
PID humPID(&hum_input, &hum_output, &hum_setpoint, Kp, Ki, Kd, DIRECT);

// Kalman filter variables
double x = 65; // initial state
double P = 1; // initial covariance
double Q = 0.00001; // process noise covariance
double R = 0.1; // measurement noise covariance
double K = 0; // Kalman gain

// Set up Code
void setup() {
Serial.begin(115200);
// Initialize the PIDs
tempPID.SetMode(AUTOMATIC);
tempPID.SetSampleTime(100);
humPID.SetMode(AUTOMATIC);
humPID.SetSampleTime(100);
// begin RTDS
dry.begin(MAX31865_3WIRE);
wet.begin(MAX31865_3WIRE);
pinMode(4,OUTPUT);
pinMode(5,OUTPUT);
}

/// Function for reading RTD's
float read_temperature() {
// Read raw temperature value
float T = wet.temperature(200, RREF);
float tw = dry.temperature(200, RREF) ;

// Apply Kalman filter
K = P / (P + R);
x = x + K * (T - x);
P = (1 - K) * P + Q;

// Convert to Fahrenheit and return filtered temperature value
float temperatureF = 1.8 * x + 32.0;
float twF = 1.8*tw + 32.0;
// Compute humidity
float Ed =  6.112 * exp((17.67 * T)/(T + 243.5));
float Ew = 6.112 * exp((17.67 * tw)/(tw + 243.5));
float RH = 100*(Ew - 0.6687*(1+0.0015*tw)*(T-tw))/Ed;
 
//Print values back to Python to plot
Serial.print(String(temperatureF));
Serial.print(",");
Serial.print(String(temperatureF)); // Change to material if desired
Serial.print(",");
Serial.println(String(RH));
delay(500);
// Apply initial fail_safe
if(temperatureF > 350.0){
digitalWrite(3,LOW);
} // 
return temperatureF;
}
//Loop
void loop() {
  if (Serial.available() > 0) { // Check for new inputs

    String line = Serial.readStringUntil('\n'); // read the inputted string 
    // Use Delimeter and Subsets to find temp, humidity, and times from input
    String setpoints_hold_times = line.substring(0, line.length() - 1);
    String setpoints_hold_times_array[100];
    int i = 0;
    int j = 0;
    
    for (i = 0; i < setpoints_hold_times.length(); i++) {
      if (setpoints_hold_times[i] == '\n') {
        j++;
        i++;
      }
      setpoints_hold_times_array[j] += setpoints_hold_times[i];
    }
    int length = j + 1;
// Use Delimeter and Subsets to find temp, humidity, and times from input
    for (i = 0; i < length; i++) {
      // Update setpoints
      String setpoint_hold_time_humidity = setpoints_hold_times_array[i];
      int comma1 = setpoint_hold_time_humidity.indexOf(',');
      int comma2 = setpoint_hold_time_humidity.indexOf(',', comma1 + 1);
      temp_setpoint = setpoint_hold_time_humidity.substring(0, comma1).toDouble();
      hum_setpoint = setpoint_hold_time_humidity.substring(comma1 + 1, comma2).toDouble();
      float hold_time = setpoint_hold_time_humidity.substring(comma2 + 1).toInt();
      hold_time = hold_time*60;
      // Now read temperature
      temp_input = read_temperature();
      //Serial.println(String(hold_time*1000.0));


      if (temp_setpoint < 0) {
        // Low temp Control cryogenic cooling valve
        unsigned long start_time = millis(); // start timer
        while ((millis() - start_time) < hold_time * 1000) {
          temp_input = read_temperature();
          //hum_input = read_humidity(); Wet bulb not working
          tempPID.Compute();
          humPID.Compute();
          digitalWrite(5,LOW);
          digitalWrite(4,temp_output>0 ? LOW:HIGH);
          digitalWrite(3, LOW);
          //digitalWrite(6, hum_output > 0 ? LOW : HIGH); // wet bulb not working
          //digitalWrite(5, hum_output < 0 ? LOW : HIGH); // wet bulb not working
          
        }
      } else if (temp_setpoint < temp_input) {
        
        // Control refrigeration compressor
        unsigned long start_time = millis();
        while ((millis() - start_time) < hold_time * 1000) {
        
          temp_input = read_temperature();
          //hum_input = read_humidity();// Wet bulb not working
          tempPID.Compute();
          humPID.Compute();
          digitalWrite(5, LOW);
          digitalWrite(4,temp_output>0 ? LOW:HIGH);
          if(temp_input < temp_setpoint){ // if we overshoo, need to heat up
          digitalWrite(3, HIGH);
          }else{
           digitalWrite(3, LOW); 
          }
          //digitalWrite(6, hum_output > 0 ? LOW : HIGH);
          //digitalWrite(5, hum_output < 0 ? LOW : HIGH);
          
        }
      }else{ // Heating required
        unsigned long start_time = millis();
        unsigned long end_time = start_time;
        while (millis() - start_time < hold_time * 1000) {
          temp_input = read_temperature();
                if(temp_input > 350.0){ // FAILSAFE
        digitalWrite(3,LOW);
          }else{
          
          //hum_input = read_humidity();
          tempPID.Compute();
          
          humPID.Compute();
          digitalWrite(5, LOW);
          if(temp_input >(temp_setpoint+3)){ // Turn on compressor for overshoot
            digitalWrite(4, HIGH);
          }else{
          digitalWrite(4, LOW);
          }
          analogWrite(3, temp_output  ); // Send PID signal to heater
         // digitalWrite(6, hum_output > 0 ? LOW : HIGH);
          //digitalWrite(5, hum_output < 0 ? LOW : HIGH);
          delay(500);
          end_time = millis();
          }
          
        }

      }
    }
    float temp = read_temperature();
    // Turn stuff off if idle
      digitalWrite(5, LOW);//
      digitalWrite(4, LOW);//
      digitalWrite(3, LOW);//
    
  }
  // Turn stuff off if idle
  float temp = read_temperature();
  digitalWrite(5, LOW);
  digitalWrite(4, LOW);
  digitalWrite(3, LOW);
  }

